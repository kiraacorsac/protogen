#include <Arduino.h>
#include "config.h"

uint8_t hexCharToByte(char c)
{
    if (c >= '0' && c <= '9')
    {
        return (c - '0') * 16;
    }
    if (c >= 'A' && c <= 'F')
    {
        return (c - 'A' + 10) * 16;
    }
    return 0;
}

uint8_t getColorMonochromeHex(char *data, String animation, String display, String frame, int x, int y)
{
    return hexCharToByte(data[x * 16 + y]);
}

uint8_t XY(uint8_t x, uint8_t y)
{
    // any out of bounds address maps to the first hidden pixel
    if ((x >= LED_DISPLAY_WIDTH) || (y >= LED_DISPLAY_HEIGHT))
    {
        return 0;
    }

    const uint8_t XYTable[] = {
        0, 31, 32, 63, 64, 95, 96, 127, 128, 159, 160, 191, 192, 223, 224, 255,
        1, 30, 33, 62, 65, 94, 97, 126, 129, 158, 161, 190, 193, 222, 225, 254,
        2, 29, 34, 61, 66, 93, 98, 125, 130, 157, 162, 189, 194, 221, 226, 253,
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        15, 16, 47, 48, 79, 80, 111, 112, 143, 144, 175, 176, 207, 208, 239, 240};

    uint8_t i = (y * LED_DISPLAY_WIDTH) + x;
    uint8_t j = XYTable[i];

    return j;
}